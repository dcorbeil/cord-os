## layers/meta-cord/conf/layer.conf
```bitbake
# We have a conf and classes directory, add to BBPATH
BBPATH .= ":${LAYERDIR}"

# We have recipes-* directories, add to BBFILES
BBFILES += "${LAYERDIR}/recipes-*/*/*.bb \
            ${LAYERDIR}/recipes-*/*/*.bbappend"

BBFILE_COLLECTIONS += "meta-cord"
BBFILE_PATTERN_meta-cord = "^${LAYERDIR}/"
BBFILE_PRIORITY_meta-cord = "9"

LAYERDEPENDS_meta-cord = "core meta-arm"
LAYERSERIES_COMPAT_meta-cord = "scarthgap"
```

## layers/meta-cord/conf/machine/beaglebone-black.conf
```bitbake
# Machine configuration for the Beaglebone Black product

require include/common.inc

# Adds "ti-soc" and "ti33x" to MACHINEOVERRIDES, and ultimately to
# OVERRIDES
require conf/machine/include/soc-family.inc
SOC_FAMILY = "ti-soc:ti33x"

# Defines instruction sets and tunes for the CPU in the SoC
require conf/machine/include/arm/armv7a/tune-cortexa8.inc
DEFAULTTUNE = "armv7athf-neon"

# Basic info about the hardware
MACHINE_FEATURES = "apm usbgadget usbhost alsa"
SERIAL_CONSOLES = "115200;ttyS0"

# Select kernel recipe, set parameters for kernel build
PREFERRED_PROVIDER_virtual/kernel ?= "linux-kiss"
KERNEL_DEVICETREE = "ti/omap/am335x-boneblack.dtb ti/omap/am335x-boneblack-wireless.dtb"
KERNEL_IMAGETYPE = "zImage"

# Select bootloader recipe, set parameters for bootloader build
PREFERRED_PROVIDER_virtual/bootloader ?= "u-boot-kiss"
UBOOT_ARCH = "arm"
UBOOT_MACHINE = "am335x_evm_config"
UBOOT_MAKE_TARGET = " DEVICE_TREE=am335x-boneblack"
UBOOT_ENTRYPOINT = "0x80008000"
UBOOT_LOADADDRESS = "0x80008000"
UBOOT_BINARY = "u-boot.img"
# Simple explanation of the Beaglebone's boot sequence:
# The AM335x BOOT rom will load MLO from storage (MLO comes from u-boot, aka u-boot secondary program
# loader (SPL)) and then MLO loads u-boot.img also from storage.
# From section 6.3.1 of the Beaglebone Black's datasheet:
#   After the primary boot code in the processor ROM passes control, a secondary stage (secondary
#   program loader – “SPL” or “MLO”) takes over. The SPL stage initializes only the required devices
#   to continue the boot process, and then control is transferred to the third stage “U-boot”
# I don't know where the source code for MLO comes from.
SPL_BINARY = "MLO"

# When wanting to boot from and SD cardIf the Beaglebone black is booted without the boot button pressed
# On Beaglebone Black, when we want to boot from the SD card, the boot button needs to be pressed
# at power on. Or else, the bootloader from the emmc is used. Depending on when the Beaglebone was
# manufactured, there is a chance that uboot inside the emmc will try to boot using am335x-boneblack-revd.dtb (mine had U-Boot SPL 2022.04-gc6f4cf7d)
# and that version of the device tree not in mainline kernel. This rev d version contains an update
# to which HDMI chip is used. If there are no plans for the user to use hdmi, no need to use the rev d variant.
# More information: https://forum.beagleboard.org/t/faq-beaglebone-black-rev-d-ite-hdmi/42303
# From the v6.12.34-ti-arm32-r12 branch containing rev d device tree:
#       https://github.com/beagleboard/linux/blob/9e419b26243bd7efcd103ae0f6456f828592b34b/arch/arm/boot/dts/ti/omap/am335x-boneblack-revd.dts
# From master not containing hdmi update (pre rev d):
#       https://github.com/beagleboard/linux/blob/master/arch/arm/boot/dts/ti/omap/am335x-boneblack.dts
# It don't know why the rev d version hasn't made it's way to upstream linux or why it is not in
# Beaglebone's master.
# UBOOT_EXTLINUX_FDT="../am335x-boneblack.dtb"

# We need MLO and u-boot.img in /boot (wic will copy them to the FAT
# partition). Expanding PREFERRED_PROVIDER_virtual/bootloader instead of
# writing u-boot-kiss allows this line to work even in case the bootloader
# is overridden, e.g. via local.conf.
IMAGE_INSTALL:append = " ${PREFERRED_PROVIDER_virtual/bootloader}"
```
